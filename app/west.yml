## app/west.yml
```yaml
manifest:
    version: 1.2

    projects:
        # Nordic's nRF Connect SDK
        - name: nrf
          url: https://github.com/nrfconnect/sdk-nrf
          revision: v2.7.0
          import:
              file: west.yml
              path-prefix: deps
              name-allowlist:
                  - cmsis
                  - hal_nordic
                  - nrfxlib
                  - zephyr
        # Capbot's zephyr board definitions
        - name: capbot-zephyr-boards
          url: https://gitlab.kuleuven.be/distrinet/taskforces/nes/freebot/zephyr-boards
          revision: zephyr-module # TODO: checkout specific version once stable
          path: deps/modules/capbot/boards
        # Capbot's zephyr library
        - name: capbot-zephyr-library
          url: https://gitlab.kuleuven.be/distrinet/taskforces/nes/freebot/zephyr-library
          revision: v2.0
          path: deps/modules/capbot/lib

    self:
        path: app
```
